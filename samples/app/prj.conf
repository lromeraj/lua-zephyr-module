## CMakeLists.txt
```
cmake_minimum_required(VERSION 3.20.0)

# ┌─────────────────────────────────────────────┐
# │             Zephyr dependencies             │
# └─────────────────────────────────────────────┘

# Get absolute (real path) to the Lua module base folder
#get_filename_component(
#  LUA_MODULE_PATH ${CMAKE_CURRENT_SOURCE_DIR}/../ REALPATH 
#)

# Get absolute (real path) to the Iiridium module base folder
#get_filename_component(
#  IRIDIUM_MODULE_PATH ${CMAKE_CURRENT_SOURCE_DIR}/iridium/ REALPATH
#)

# Append module path to the extra modules list
#list( APPEND ZEPHYR_EXTRA_MODULES ${LUA_MODULE_PATH} )
#list( APPEND ZEPHYR_EXTRA_MODULES ${IRIDIUM_MODULE_PATH} )

if( "${DEBUG}" STREQUAL "yes" )
	list( APPEND OVERLAY_CONFIG "dbg.conf" )
endif()

if(DEFINED QEMU_TTY_PATH)
  set(
    ENV{QEMU_EXTRA_FLAGS}
    "-chardev serial,id=con1,path=${QEMU_TTY_PATH} -serial chardev:con1" )
endif()

find_package(Zephyr REQUIRED HINTS $ENV{ZEPHYR_BASE})
project(lua_app)

target_sources(app PRIVATE
  src/main.c
)

# This is a simple wrapper which compiles lua files
# and generates a header file with the binary content
# The output header name will be, for example:
# /my/path/main.lua -> /my/path/main.lbc.h
generate_lua_inc_file_for_target(
  app
  lua/main.lua
)

# file(GLOB LUA_SOURCES "lua/*.lua")

# generate_lua_byte_code_for_target(
# 	app
# 	${LUA_SOURCES}
# )
```

## prj.conf
```kconfig
#CONFIG_FLASH=y
CONFIG_PRINTK=y
#CONFIG_SERIAL=y

# for QEMU
CONFIG_QEMU_ICOUNT=n

#CONFIG_ASSERT=y
#CONFIG_FILE_SYSTEM=y

# If picolibc is used, CONFIG_POSIX_API is required since
# the toolchain and also the module build only tinystdio module
# which relies on POSIX API 
#CONFIG_PICOLIBC=y
#CONFIG_POSIX_API=y

# for newlib C
CONFIG_NEWLIB_LIBC=y
#CONFIG_COMMON_LIBC_REMOVE=y

#CONFIG_REQUIRES_FLOAT_PRINTF=y
#CONFIG_NEWLIB_LIBC_FLOAT_PRINTF=y
#CONFIG_NEWLIB_LIBC_FLOAT_SCANF=y

CONFIG_MAIN_STACK_SIZE=8192

## Memory
CONFIG_HEAP_MEM_POOL_SIZE=262144
# CONFIG_HEAP_MEM_POOL_SIZE=150000
# CONFIG_HEAP_MEM_POOL_SIZE=16384

CONFIG_MAIN_THREAD_PRIORITY=15

# Logging
CONFIG_LOG=y
#CONFIG_LOG_PROCESS_THREAD_PRIORITY=0
#CONFIG_LOG_PROCESS_THREAD_CUSTOM_PRIORITY=y
CONFIG_LOG_PROCESS_TRIGGER_THRESHOLD=1

CONFIG_LOG_MAX_LEVEL=3
CONFIG_LOG_DEFAULT_LEVEL=3
CONFIG_LOG_BACKEND_SHOW_COLOR=y
CONFIG_LOG_BACKEND_FORMAT_TIMESTAMP=n

# Build Iridium library
CONFIG_LUA=y
CONFIG_LUA_GLOCK=n
CONFIG_LUA_PRINTK=y
```

## dbg.conf
```kconfig
CONFIG_LOG_MAX_LEVEL=4
CONFIG_LOG_DEFAULT_LEVEL=4
```

## boards/esp32c3_devkitm.conf
```kconfig
CONFIG_HEAP_MEM_POOL_SIZE=150000
```

## src/main.c
```c
#include <zephyr/device.h>
#include <zephyr/drivers/uart.h>
#include <zephyr/usb/usb_device.h>
#include <zephyr/storage/disk_access.h>
#include <zephyr/fs/fs.h>
#include <string.h>
#include <stdio.h>
#include <stdlib.h>
#include <math.h>

#include "lauxlib.h"
#include "lualib.h"

#include "luac.h"

LOG_MODULE_REGISTER(app);

// For reference
// https://www.lua.org/pil/24.1.html
// https://docs.zephyrproject.org/latest/contribute/bin_blobs.html

static int l_z_sleep(lua_State *L);

static const struct luaL_Reg l_zephyr[] = {
  {"sleep", l_z_sleep },
  {NULL, NULL}  /* sentinel */
};

static int l_z_sleep(lua_State *L) {
  lua_Number sleep_ms = luaL_checknumber(L, 1);
  
  k_sleep(K_MSEC(sleep_ms));
  return 0;
}

int luaopen_zephyr(lua_State *L) {

  lua_newtable(L);
  luaL_setfuncs(L, l_zephyr, 0);

  lua_setglobal(L, "z");

  return 1;
}

int main(void) {

  static lua_State * L;

  L = luaL_newstate();

  luaL_openlibs(L);
  luaopen_zephyr(L);
  
  // lua_pushcfunction( L, l_sin );
  // lua_setglobal( L, "mysin" );
  int error = 
    luaL_loadbuffer(L, g_lua_main, sizeof(g_lua_main), "main") 
    || lua_pcall(L, 0, 0, 0);

  if (error) {
    // lua_tostring() returns and appends 
    // at the same time the value in the stack
    LOG_ERR("%s", lua_tostring(L, -1));
    lua_pop(L, 1); 
  }

  lua_close(L);
  
  return 0;
}
```
