## CMakeLists.txt
```
cmake_minimum_required(VERSION 3.20.0)

# ┌─────────────────────────────────────────────┐
# │             Zephyr dependencies             │
# └─────────────────────────────────────────────┘

# Get absolute (real path) to the Lua module base folder
get_filename_component(
  LUA_MODULE_PATH ${CMAKE_CURRENT_SOURCE_DIR}/../ REALPATH )

# Get absolute (real path) to the Iiridium module base folder
get_filename_component(
  IRIDIUM_MODULE_PATH ${CMAKE_CURRENT_SOURCE_DIR}/iridium/ REALPATH )

# Append module path to the extra modules list
list( APPEND ZEPHYR_EXTRA_MODULES ${LUA_MODULE_PATH} )
list( APPEND ZEPHYR_EXTRA_MODULES ${IRIDIUM_MODULE_PATH} )

if( "${DEBUG}" STREQUAL "yes" )
	list( APPEND OVERLAY_CONFIG "dbg.conf" )
endif()

if(DEFINED QEMU_TTY_PATH)
  set(
    ENV{QEMU_EXTRA_FLAGS}
    "-chardev serial,id=con1,path=${QEMU_TTY_PATH} -serial chardev:con1" )
endif()

find_package(Zephyr REQUIRED HINTS $ENV{ZEPHYR_BASE})
project( lua_zepphyr_app )

target_sources( app PRIVATE
  ./src/main.c
)

target_link_libraries( app PRIVATE lua iridium )

# This is a simple wrapper which compiles lua files
# and generates a header file with the binary content
# The output header name will be, for example:
# /my/path/main.lua -> main.lua.h
lua_generate_inc_file_for_target(
  app
  ${CMAKE_CURRENT_SOURCE_DIR}/lua/main.lua
)
```

## prj.conf
```kconfig
CONFIG_LUA=y
CONFIG_IRIDIUM=y
CONFIG_FLASH=y
CONFIG_PRINTK=y
CONFIG_SERIAL=y
CONFIG_ASSERT=y
CONFIG_NEWLIB_LIBC=y
CONFIG_NEWLIB_LIBC_FLOAT_PRINTF=y
CONFIG_NEWLIB_LIBC_FLOAT_SCANF=y
CONFIG_MAIN_STACK_SIZE=16384
CONFIG_QEMU_ICOUNT=n

# Move to lua
CONFIG_FILE_SYSTEM=y

## Memory
CONFIG_HEAP_MEM_POOL_SIZE=262144
# CONFIG_HEAP_MEM_POOL_SIZE=150000
# CONFIG_HEAP_MEM_POOL_SIZE=16384

# Logging
CONFIG_LOG=y
CONFIG_LOG_PROCESS_THREAD_PRIORITY=0
CONFIG_LOG_PROCESS_THREAD_CUSTOM_PRIORITY=y

CONFIG_LOG_MAX_LEVEL=3
CONFIG_LOG_DEFAULT_LEVEL=3
CONFIG_LOG_BACKEND_SHOW_COLOR=y
CONFIG_LOG_BACKEND_FORMAT_TIMESTAMP=n

CONFIG_KERNEL_LOG_LEVEL_ERR=y
```

## dbg.conf
```kconfig
CONFIG_SERIAL=y
CONFIG_LOG=y
CONFIG_LOG_MAX_LEVEL=4
CONFIG_LOG_DEFAULT_LEVEL=4
CONFIG_LOG_BACKEND_SHOW_COLOR=y
CONFIG_LOG_BACKEND_FORMAT_TIMESTAMP=n
```

## src/main.c
```c
#include <zephyr/device.h>
#include <zephyr/drivers/uart.h>
#include <zephyr/usb/usb_device.h>
#include <zephyr/storage/disk_access.h>
#include <zephyr/fs/fs.h>
#include <string.h>
#include <stdio.h>
#include <stdlib.h>
#include <math.h>

#include "lauxlib.h"
#include "lualib.h"

#include "isbd.h"
#include "luac.h"

#include "shared.h"

LOG_MODULE_REGISTER( app );

static struct device *uart_960x_device = UART_960X_DEVICE;

// For reference
// https://www.lua.org/pil/24.1.html
// https://docs.zephyrproject.org/latest/contribute/bin_blobs.html

static isu_dte_t g_isu_dte;

static int l_isbd_setup( lua_State *L );
static int l_isbd_wait_event( lua_State *L );
static int l_isbd_send_msg( lua_State *L );
static int l_isbd_request_session( lua_State *L );

static const struct luaL_Reg l_isbd[] = {
  {"setup", l_isbd_setup },
  {"waitEvent", l_isbd_wait_event },
  {"sendMessage", l_isbd_send_msg },
  {"requestSession", l_isbd_request_session },
  {NULL, NULL}  /* sentinel */
};

static uint8_t rx_buf[ 512 ];
static uint8_t tx_buf[ 512 ];

static int l_isbd_setup( lua_State *L ) {

  // TODO: allow configuration from Lua

  struct uart_config uart_config;

	uart_config_get( uart_960x_device, &uart_config );
	uart_config.baudrate = 19200;
	uart_configure( uart_960x_device, &uart_config );

  isu_dte_config_t isu_dte_config = {
    .at_uart = {
      .echo = false,
      .verbose = true,
      // .zuart = ZUART_CONF_POLL( uart_960x_device ),
      .zuart = ZUART_CONF_IRQ( uart_960x_device, rx_buf, sizeof( rx_buf ), tx_buf, sizeof( tx_buf ) ),
      // .zuart = ZUART_CONF_MIX_RX_IRQ_TX_POLL( uart_960x_device, rx_buf, sizeof( rx_buf ) ),
      // .zuart = ZUART_CONF_MIX_RX_POLL_TX_IRQ( uart_960x_device, tx_buf, sizeof( tx_buf ) ),
    }
  };

  lua_pushnumber( L, isu_dte_setup( &g_isu_dte, &isu_dte_config ) );

  isbd_config_t isbd_config = {
    .dte            = &g_isu_dte,
    .priority       = 0,
    .mo_queue_len   = 4,
    .evt_queue_len  = 8,
    .sigq_threshold = 2,
  };

  isbd_setup( &isbd_config );

  return 1;
}

static int l_isbd_send_msg( lua_State *L ) {

  size_t msg_len;
  const char *msg = luaL_checklstring( L, 1, &msg_len );
  lua_Number retries = luaL_checknumber( L, 2 );

  isbd_send_mo_msg( msg, (uint16_t)msg_len, (uint8_t)retries );
  
  return 0;
}

static int l_isbd_request_session( lua_State *L ) {

  luaL_checktype( L, 1, LUA_TTABLE );
  lua_getfield( L, 1, "alert" );

  bool alert = lua_toboolean( L, -1 );

  isbd_request_session( alert );
  
  return 0;
}


static int l_isbd_wait_event( lua_State *L ) {

  isbd_evt_t evt;
  lua_Number timeout_ms = luaL_checknumber( L, 1 );

  if ( isbd_wait_evt( &evt, (uint32_t)timeout_ms ) ) {
    
    if ( evt.id == ISBD_EVT_MT ) {

      lua_pushnumber( L, 0x01 );
      
      lua_createtable( L, 0, 2 );

      // payload
      lua_pushstring( L, "payload" );
      lua_pushlstring( L, (const char*)evt.mt.data, evt.mt.len );
      lua_settable( L, -3 );

      // sn
      lua_pushstring( L, "sn" );
      lua_pushnumber( L, evt.mt.sn );
      lua_settable( L, -3 );

    } else if ( evt.id == ISBD_EVT_MO ) {
      
      lua_pushnumber( L, 0x02 );

      lua_createtable( L, 0, 2 );

      lua_pushstring( L, "payload" );
      lua_pushlstring( L, (const char*)evt.mo.data, evt.mo.len );
      lua_settable( L, -3 );
      
      lua_pushstring( L, "sn" );
      lua_pushnumber( L, evt.mo.sn );
      lua_settable( L, -3 );

    } else if ( evt.id == ISBD_EVT_RING ) {
      
      lua_pushnumber( L, 0x03 );
      lua_pushnil( L );

    } else if ( evt.id == ISBD_EVT_SVCA ) {
      
      lua_pushnumber( L, 0x04 );

      lua_createtable( L, 0, 1 );

      lua_pushstring( L, "svca" );
      lua_pushnumber( L, evt.svca );
      lua_settable( L, -3 );
    
    } else if ( evt.id == ISBD_EVT_SIGQ ) {

      lua_pushnumber( L, 0x05 );

      lua_createtable( L, 0, 1 );

      lua_pushstring( L, "sigq" );
      lua_pushnumber( L, evt.sigq );
      lua_settable( L, -3 );

    } else if ( evt.id == ISBD_EVT_ERR ) {

      lua_pushnumber( L, 0x0F );
      
      lua_createtable( L, 0, 1 );

      lua_pushstring( L, "err" );
      lua_pushnumber( L, evt.err );
      lua_settable( L, -3 );

    } else {
      return 0;
    }

    isbd_destroy_evt( &evt );

    return 2;
  }

  return 0;

}

int luaopen_iridium( lua_State *L ) {

  lua_newtable( L );
  luaL_setfuncs( L, l_isbd, 0 );

  // lua_pushvalue( L, -1 ); // pluck these lines out if they offend you

  lua_setglobal( L, "isbd" );

  // luaL_openlib( L, "iridium", l_iridium, 0 );
  return 1;
}

int main(void) {

  static lua_State * L;

  L = luaL_newstate();

  luaL_openlibs( L );
  luaopen_iridium( L );
  
  // lua_pushcfunction( L, l_sin );
  // lua_setglobal( L, "mysin" );
  int error = 
    luaL_loadbuffer( L, g_lua_main, sizeof( g_lua_main ), "main" ) 
    || lua_pcall( L, 0, 0, 0 );

  if ( error ) {
    // lua_tostring() returns and appends 
    // at the same time the value in the stack
    LOG_ERR( "%s", lua_tostring( L, -1 ) );
    lua_pop( L, 1 ); 
  }

  lua_close( L );
  
  return 0;
}
```

## src/luac.h
```c
#ifndef LUA_SOURCE_H_
	#define LUA_SOURCE_H_
	static const unsigned char g_lua_main[] = {
		#include "main.lua.h"
	};
#endif
```

## src/shared.h
```c
#define UART_960X_NODE       DT_ALIAS( 960x )
#define UART_960X_NODE_DEF   DT_NODELABEL( uart1 )

#if DT_NODE_HAS_STATUS( UART_960X_NODE, okay )

	#define UART_960X_DEVICE \
		(struct device*)DEVICE_DT_GET( UART_960X_NODE );

#elif DT_NODE_HAS_STATUS( UART_960X_NODE_DEF, okay )

	#define UART_960X_DEVICE \
    (struct device*)DEVICE_DT_GET( UART_960X_NODE_DEF );

#else
  #error  "Additional UART is mandatory to communicate with the modem," \
          "specify 960x alias in your board specific overlay"
#endif
```

## src/shell.c
```c
#include <zephyr/device.h>
#include <zephyr/shell/shell.h>
#include <zephyr/fs/fs.h>
#include <ff.h>

#include "lua/lauxlib.h"
#include "lua/lua.h"

extern lua_State* L;

void cmd_lua_loadfile(const struct shell * shell, size_t argc, char ** argv) {
    if (argc == 2) {
        char* path = argv[1];

        // Load init.lua
        struct fs_file_t init;
        fs_file_t_init(&init);
        if(0 == fs_open(&init, path, 1)) {
            fs_seek(&init, 0, FS_SEEK_END);
            size_t size = fs_tell(&init);
            char * str = malloc(size+1);
            str[size] = 0;
            fs_seek(&init, 0, FS_SEEK_SET);
            fs_read(&init, str, size);
            int err = luaL_dostring(L, str);
            if (err) {shell_print(shell, "Lua file executed with errors: %i", err);} else {
                shell_print(shell, "Lua file executed successfully.");
            }
            free(str);
        } else {
            shell_print(shell, "Could not open the file %s", path);
        }
        fs_close(&init);
    } else {
        shell_print(shell, "Invalid # of arguments %i", argc);
    }
}

void cmd_lua(const struct shell * shell, size_t argc, char ** argv) {
    if (argc == 2) {
        char* arg = argv[1];
        luaL_loadstring(L, arg);
        int err = lua_pcall(L, 0, 0, 0);
        if (err) {
            const char* str = luaL_checkstring(L, 1);
            if (str) {
                shell_print(shell, "<ERR %i: %s>", err, str);
                lua_pop(L, 1);
            } else {
                shell_print(shell, "<ERR %i>", err);
            }
        }
        fflush(stdout);
    } else if (argc == 1) {
        shell_print(shell, "Lua 5.4.4 %i", L);
    } else {
        shell_print(shell, "Invalid # of arguments %i", argc);
    }
}

SHELL_CMD_REGISTER(lua, NULL, "Execute lua code", cmd_lua);
SHELL_CMD_REGISTER(lua_lf, NULL, "Run the given lua file", cmd_lua_loadfile);
```
